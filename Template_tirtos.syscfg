/**
 * These arguments were used when this file was generated. They will be automatically applied on subsequent loads
 * via the GUI or CLI. Run CLI with '--help' for additional information on how to override these arguments.
 * @cliArgs --board "/ti/boards/MSP_EXP432P401R" --product "simplelink_msp432p4_sdk@3.40.01.02"
 * @versions {"tool":"1.17.0+3128"}
 */

/**
 * Import the modules used in this configuration.
 */
const GPIO    = scripting.addModule("/ti/drivers/GPIO");
const GPIO1   = GPIO.addInstance();
const GPIO2   = GPIO.addInstance();
const GPIO3   = GPIO.addInstance();
const GPIO4   = GPIO.addInstance();
const GPIO5   = GPIO.addInstance();
const GPIO6   = GPIO.addInstance();
const GPIO7   = GPIO.addInstance();
const GPIO8   = GPIO.addInstance();
const GPIO9   = GPIO.addInstance();
const GPIO10  = GPIO.addInstance();
const GPIO11  = GPIO.addInstance();
const GPIO12  = GPIO.addInstance();
const GPIO13  = GPIO.addInstance();
const GPIO14  = GPIO.addInstance();
const GPIO15  = GPIO.addInstance();
const GPIO16  = GPIO.addInstance();
const GPIO17  = GPIO.addInstance();
const GPIO18  = GPIO.addInstance();
const GPIO19  = GPIO.addInstance();
const GPIO20  = GPIO.addInstance();
const I2C     = scripting.addModule("/ti/drivers/I2C", {}, false);
const I2C1    = I2C.addInstance();
const PWM     = scripting.addModule("/ti/drivers/PWM", {}, false);
const PWM1    = PWM.addInstance();
const PWM2    = PWM.addInstance();
const RTOS    = scripting.addModule("/ti/drivers/RTOS");
const SPI     = scripting.addModule("/ti/drivers/SPI", {}, false);
const SPI1    = SPI.addInstance();
const SPI2    = SPI.addInstance();
const Timer   = scripting.addModule("/ti/drivers/Timer", {}, false);
const Timer1  = Timer.addInstance();
const UART    = scripting.addModule("/ti/drivers/UART");
const UART1   = UART.addInstance();
const UART2   = UART.addInstance();
const UART3   = UART.addInstance();
const Button  = scripting.addModule("/ti/drivers/apps/Button", {}, false);
const Button1 = Button.addInstance();
const Button2 = Button.addInstance();
const LED     = scripting.addModule("/ti/drivers/apps/LED", {}, false);
const LED1    = LED.addInstance();
const LED2    = LED.addInstance();
const LED3    = LED.addInstance();
const LED4    = LED.addInstance();

/**
 * Write custom configuration values to the imported modules.
 */
GPIO1.$name = "C_S";
GPIO1.mode  = "Output";

GPIO2.$name = "D0";
GPIO2.mode  = "Output";

GPIO3.$name = "D1";
GPIO3.mode  = "Output";

GPIO4.$name = "DC";
GPIO4.mode  = "Output";

GPIO5.$name = "RES";
GPIO5.mode  = "Output";

GPIO6.$name = "Left_IN1";
GPIO6.mode  = "Output";

GPIO7.$name = "Left_IN2";
GPIO7.mode  = "Output";

GPIO8.$name = "Right_IN1";
GPIO8.mode  = "Output";

GPIO9.$name = "Right_IN2";
GPIO9.mode  = "Output";

GPIO10.$name = "CONFIG_GPIO_4";

GPIO11.$name = "SPI_0CS";
GPIO11.mode  = "Output";

GPIO12.$name = "SPI_0DC";
GPIO12.mode  = "Output";

GPIO13.$name              = "SPI_0BLK";
GPIO13.mode               = "Output";
GPIO13.initialOutputState = "High";

GPIO14.mode  = "Output";
GPIO14.$name = "SPI_0RES";

GPIO15.$name           = "LED_L2";
GPIO15.gpioPin.$assign = "expansion.18";

GPIO16.$name           = "LED_L1";
GPIO16.gpioPin.$assign = "expansion.14";

GPIO17.$name           = "LED_M";
GPIO17.gpioPin.$assign = "expansion.12";

GPIO18.$name           = "LED_R1";
GPIO18.gpioPin.$assign = "expansion.10";

GPIO19.$name           = "LED_R2";
GPIO19.gpioPin.$assign = "expansion.8";

GPIO20.$name = "CONFIG_GPIO_2";

I2C1.$name = "CONFIG_I2C_0";

PWM1.$name = "PWM_Left";

PWM2.$name = "PWM_Right";

const Power                   = scripting.addModule("/ti/drivers/Power", {}, false);
Power.performanceLevel3.$name = "ti_drivers_power_PowerMSP432PerfLevels0";
Power.performanceLevel2.$name = "ti_drivers_power_PowerMSP432PerfLevels1";
Power.performanceLevel1.$name = "ti_drivers_power_PowerMSP432PerfLevels2";
Power.performanceLevel0.$name = "ti_drivers_power_PowerMSP432PerfLevels3";


SPI1.$name = "SPI_1";

SPI2.mode  = "Four Pin SS Active High";
SPI2.$name = "SPI_2";

Timer1.timerType = "32 Bits";
Timer1.$name     = "Timer32";

UART1.$name              = "UART1";
UART1.baudRates          = [9600,115200];
UART1.uart.$assign       = "EUSCI_A1";
UART1.uart.txPin.$assign = "boosterpack.32";
UART1.uart.rxPin.$assign = "boosterpack.31";

UART2.$name              = "PC_UART";
UART2.uart.$assign       = "EUSCI_A2";
UART2.uart.txPin.$assign = "boosterpack.34";
UART2.uart.rxPin.$assign = "boosterpack.18";

UART3.$name              = "UART3";
UART3.uart.txPin.$assign = "expansion.22";
UART3.uart.rxPin.$assign = "expansion.19";

Button1.$hardware     = system.deviceData.board.components.S1;
Button1.$name         = "BUTTON_1";
Button1.gpioPin.$name = "CONFIG_GPIO_0";

Button2.$hardware     = system.deviceData.board.components.S2;
Button2.$name         = "BUTTON_2";
Button2.gpioPin.$name = "CONFIG_GPIO_1";

LED1.$hardware = system.deviceData.board.components.LED1_RED;
LED1.$name     = "LED_Red1";

LED2.$hardware = system.deviceData.board.components.LED2_RED;
LED2.$name     = "LED_Red2";

LED3.$hardware = system.deviceData.board.components.LED2_GREEN;
LED3.$name     = "LED_Green";

LED4.$hardware = system.deviceData.board.components.LED2_BLUE;
LED4.$name     = "LED_Blue";

/**
 * Pinmux solution for unlocked pins/peripherals. This ensures that minor changes to the automatic solver in a future
 * version of the tool will not impact the pinmux you originally saw.  These lines can be completely deleted in order to
 * re-solve from scratch.
 */
GPIO1.gpioPin.$suggestSolution               = "expansion.30";
GPIO2.gpioPin.$suggestSolution               = "boosterpack.7";
GPIO3.gpioPin.$suggestSolution               = "boosterpack.15";
GPIO4.gpioPin.$suggestSolution               = "boosterpack.14";
GPIO5.gpioPin.$suggestSolution               = "boosterpack.38";
GPIO6.gpioPin.$suggestSolution               = "boosterpack.19";
GPIO7.gpioPin.$suggestSolution               = "boosterpack.40";
GPIO8.gpioPin.$suggestSolution               = "expansion.31";
GPIO9.gpioPin.$suggestSolution               = "expansion.32";
GPIO10.gpioPin.$suggestSolution              = "expansion.21";
GPIO11.gpioPin.$suggestSolution              = "boosterpack.4";
GPIO12.gpioPin.$suggestSolution              = "boosterpack.11";
GPIO13.gpioPin.$suggestSolution              = "expansion.7";
GPIO14.gpioPin.$suggestSolution              = "expansion.5";
GPIO20.gpioPin.$suggestSolution              = "expansion.1";
I2C1.i2c.$suggestSolution                    = "EUSCI_B1";
I2C1.i2c.sdaPin.$suggestSolution             = "boosterpack.10";
I2C1.i2c.sclPin.$suggestSolution             = "boosterpack.9";
PWM1.timer.$suggestSolution                  = "Timer_A1";
PWM1.timer.pwmPin.$suggestSolution           = "boosterpack.3";
PWM2.timer.$suggestSolution                  = "Timer_A1";
PWM2.timer.pwmPin.$suggestSolution           = "boosterpack.39";
RTOS.timer0.resource.$suggestSolution        = "Timer_A0";
SPI1.spi.$suggestSolution                    = "EUSCI_B3";
SPI1.spi.sclkPin.$suggestSolution            = "expansion.28";
SPI1.spi.misoPin.$suggestSolution            = "boosterpack.35";
SPI1.spi.mosiPin.$suggestSolution            = "expansion.29";
SPI1.spi.dmaRxChannel.$suggestSolution       = "DMA_CH5";
SPI1.spi.dmaTxChannel.$suggestSolution       = "DMA_CH4";
SPI1.spi.dmaInterruptNumber.$suggestSolution = "DMA_INT2";
SPI2.spi.$suggestSolution                    = "EUSCI_B2";
SPI2.spi.sclkPin.$suggestSolution            = "expansion.26";
SPI2.spi.misoPin.$suggestSolution            = "expansion.25";
SPI2.spi.mosiPin.$suggestSolution            = "expansion.24";
SPI2.spi.dmaRxChannel.$suggestSolution       = "DMA_CH7";
SPI2.spi.dmaTxChannel.$suggestSolution       = "DMA_CH6";
SPI2.spi.dmaInterruptNumber.$suggestSolution = "DMA_INT3";
SPI2.spi.ssPin.$suggestSolution              = "expansion.23";
Timer1.timer.$suggestSolution                = "TIMER32_0";
UART3.uart.$suggestSolution                  = "EUSCI_A3";
Button1.gpioPin.gpioPin.$suggestSolution     = "P1.1.GPIO/EUSCI_A0_SPI.CLK";
Button2.gpioPin.gpioPin.$suggestSolution     = "P1.4.GPIO/EUSCI_B0_SPI.STE";
LED1.gpioPin.gpioPin.$suggestSolution        = "P1.0.GPIO/EUSCI_A0_SPI.STE";
LED2.gpioPin.gpioPin.$suggestSolution        = "P2.0.GPIO/EUSCI_A1_SPI.STE";
LED3.gpioPin.gpioPin.$suggestSolution        = "P2.1.GPIO/EUSCI_A1_SPI.CLK";
LED4.gpioPin.gpioPin.$suggestSolution        = "P2.2.GPIO/EUSCI_A1_UART.RXD/EUSCI_A1_SPI.SOMI";
